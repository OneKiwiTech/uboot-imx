## board/freescale/imx8mm_maaxboard/Kconfig
```kconfig
if TARGET_IMX8MM_MAAXBOARD

config SYS_BOARD
	default "imx8mm_maaxboard"

config SYS_VENDOR
	default "freescale"

config SYS_CONFIG_NAME
	default "imx8mm_maaxboard"

source "board/freescale/common/Kconfig"

endif
```

## board/kmt/imx8mm-demo/Kconfig
```kconfig
if TARGET_IMX8MM_DEMO

config SYS_BOARD
	default "imx8mm-demo"

config SYS_VENDOR
	default "kmt"

config SYS_CONFIG_NAME
	default "imx8mm-demo"

config TDX_CFG_BLOCK
	default y

config TDX_CFG_BLOCK_EXTRA
	default y

config TDX_HAVE_MMC
	default y

config TDX_HAVE_EEPROM_EXTRA
	default y

config TDX_CFG_BLOCK_DEV
	default "0"

config TDX_CFG_BLOCK_PART
	default "1"

# Toradex config block in eMMC, at the end of 1st "boot sector"
config TDX_CFG_BLOCK_OFFSET
	default "-512"

source "board/kmt/common/Kconfig"

endif
```
